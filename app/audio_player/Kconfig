## app/audio_player/Kconfig
```kconfig
config LVX_USE_DEMO_CONTEST2026_090_AUDIO_PLAYER
	bool "Contest 2026 team 090 audio player"
	default n
	---help---
		Lightweight WAV player daemon for SF32LB52 Huangshan Pi.
		Monitors /data/play_trigger and plays through AUDCODEC DAC.
```

## app/btpand/Kconfig
```kconfig
config LVX_USE_DEMO_CONTEST2026_090_BTPAND
        bool "BT PAN daemon (btpand)"
        default y
        ---help---
                Bluetooth PAN daemon: auto-enable, auto-pair, auto-PAN.
```
